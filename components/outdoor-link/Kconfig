## components/outdoor-link/Kconfig
```kconfig
menu "Outdoor unit link"

    config OUTDOOR_LINK_ENABLED
        bool "Link to the outdoor unit (ws_alpha)"
        default n
        help
            Off in public builds. The pairing (the outdoor unit's MAC and the
            two keys) comes from a config fragment kept outside the repository,
            as the default until the weather station settings (web page) save
            one.

    config OUTDOOR_LINK_PEER_MAC
        string "Outdoor unit's MAC (aa:bb:cc:dd:ee:ff)"
        depends on OUTDOOR_LINK_ENABLED
        default ""

    config OUTDOOR_LINK_PMK
        string "PMK, 32 hex digits"
        depends on OUTDOOR_LINK_ENABLED
        default ""

    config OUTDOOR_LINK_LMK
        string "LMK, 32 hex digits"
        depends on OUTDOOR_LINK_ENABLED
        default ""

    choice OUTDOOR_LINK_INTERVAL
        prompt "Outdoor unit's measurement interval (sent in every reply)"
        depends on OUTDOOR_LINK_ENABLED
        default OUTDOOR_LINK_INTERVAL_900
        help
            The display decides the outdoor unit's interval: it goes out with
            every reply, and the outdoor unit uses it from its next wake on.
            The default until the weather station settings save one (3 min to
            6 h there); 1 minute only from here, for the bench.

        config OUTDOOR_LINK_INTERVAL_60
            bool "1 minute (bench)"
        config OUTDOOR_LINK_INTERVAL_300
            bool "5 minutes"
        config OUTDOOR_LINK_INTERVAL_900
            bool "15 minutes"
    endchoice

    config OUTDOOR_LINK_INTERVAL_S
        int
        default 60 if OUTDOOR_LINK_INTERVAL_60
        default 300 if OUTDOOR_LINK_INTERVAL_300
        default 900

endmenu
```

## components/station-rx/Kconfig
```kconfig
menu "Weather station receiver"

    config STATION_RX_ENABLED
        bool "Receive the ws_alpha outdoor station"
        default n
        help
            Off in public builds. The pairing (the station's MAC and the two
            keys) comes from a config fragment kept outside the repository.

    config STATION_RX_PEER_MAC
        string "Station MAC (aa:bb:cc:dd:ee:ff)"
        depends on STATION_RX_ENABLED
        default ""

    config STATION_RX_PMK
        string "PMK, 32 hex digits"
        depends on STATION_RX_ENABLED
        default ""

    config STATION_RX_LMK
        string "LMK, 32 hex digits"
        depends on STATION_RX_ENABLED
        default ""

    choice STATION_RX_INTERVAL
        prompt "Measurement interval sent to the station"
        depends on STATION_RX_ENABLED
        default STATION_RX_INTERVAL_900
        help
            Sent with every reply; the station uses it from its next wake on.
            Must divide 900 s, the display's storage grid.

        config STATION_RX_INTERVAL_60
            bool "1 minute (bench)"
        config STATION_RX_INTERVAL_300
            bool "5 minutes"
        config STATION_RX_INTERVAL_900
            bool "15 minutes"
    endchoice

    config STATION_RX_INTERVAL_S
        int
        default 60 if STATION_RX_INTERVAL_60
        default 300 if STATION_RX_INTERVAL_300
        default 900

endmenu
```

## ws_alpha/main/Kconfig.projbuild
```kconfig
menu "ws_alpha"

    choice WS_ALPHA_INTERVAL
        prompt "Measurement interval until the display sets one"
        default WS_ALPHA_INTERVAL_900
        help
            From power-on to the display's first reply; after that the display
            decides (1 minute to 6 hours). Wakes are aligned to multiples of
            it. One minute is handy on the bench.

        config WS_ALPHA_INTERVAL_60
            bool "1 minute (bench)"
        config WS_ALPHA_INTERVAL_300
            bool "5 minutes"
        config WS_ALPHA_INTERVAL_900
            bool "15 minutes"
    endchoice

    config WS_ALPHA_INTERVAL_S
        int
        default 60 if WS_ALPHA_INTERVAL_60
        default 300 if WS_ALPHA_INTERVAL_300
        default 900

    config WS_ALPHA_TX_POWER_DBM
        int "Maximum transmit power, dBm"
        range 2 20
        default 20
        help
            Lower power means a lower current peak at each send, i.e. more
            margin against brownouts on a weak or cold cell. The display is
            4-10 m away; tune this down once the received signal strength
            (logged on both sides) is known.

endmenu
```
